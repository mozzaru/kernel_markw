## drivers/input/fingerprint/Kconfig
```kconfig
config INPUT_FINGERPRINT
	tristate "Fingerprint driver support"
	help
	  Say Y here to enable fingerprint driver support

if MACH_XIAOMI_MARKW
source "drivers/input/fingerprint/goodix_markw/Kconfig"
source "drivers/input/fingerprint/fpc_markw/Kconfig"
endif
```
